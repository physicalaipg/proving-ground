## real/firmware/yb-eet01-json/sdkconfig.defaults
```kconfig
# 模组 ESP32-S3-WROOM-1U-N4R2：Flash 4 MB；闪存模式与频率同厂商镜像头（DIO、80 MHz）
CONFIG_IDF_TARGET="esp32s3"
CONFIG_ESPTOOLPY_FLASHSIZE_4MB=y
CONFIG_ESPTOOLPY_FLASHMODE_DIO=y
CONFIG_ESPTOOLPY_FLASHFREQ_80M=y
# UART0 同时是协议口：应用层日志全关，避免日志行插进 JSON 帧
CONFIG_LOG_DEFAULT_LEVEL_NONE=y
# 控制环 10 ms 一拍
CONFIG_FREERTOS_HZ=1000
# 后备刹车（内部工单）：任务看门狗只监视控制任务，超时 panic 后立即复位。
# 超时 300 ms 在 app_main 里设（配置项以秒计，设不到）；panic 不打印，免得拖长到复位的时间、也免得往协议口灌字
CONFIG_ESP_TASK_WDT_PANIC=y
CONFIG_ESP_TASK_WDT_CHECK_IDLE_TASK_CPU0=n
CONFIG_ESP_TASK_WDT_CHECK_IDLE_TASK_CPU1=n
CONFIG_ESP_SYSTEM_PANIC_SILENT_REBOOT=y
```
